/**
 * @cliArgs --board "/ti/boards/LP_MSPM0G3507" --product "mspm0_sdk@2.04.00.06"
 * @versions {"tool":"1.23.1+4034"}
 */

/**
 * Import the modules used in this configuration.
 */
const GPIO    = scripting.addModule("/ti/driverlib/GPIO", {}, false);
const GPIO1   = GPIO.addInstance();
const GPIO2   = GPIO.addInstance();
const GPIO3   = GPIO.addInstance();
const GPIO4   = GPIO.addInstance();
const GPIO5   = GPIO.addInstance();
const PWM     = scripting.addModule("/ti/driverlib/PWM", {}, false);
const PWM1    = PWM.addInstance();
const SYSCTL  = scripting.addModule("/ti/driverlib/SYSCTL");
const SYSTICK = scripting.addModule("/ti/driverlib/SYSTICK");
const TIMER   = scripting.addModule("/ti/driverlib/TIMER", {}, false);
const TIMER1  = TIMER.addInstance();
const UART    = scripting.addModule("/ti/driverlib/UART", {}, false);
const UART1   = UART.addInstance();

/**
 * Write custom configuration values to the imported modules.
 */
GPIO1.$name                          = "TB6612";
GPIO1.port                           = "PORTB";
GPIO1.associatedPins.create(4);
GPIO1.associatedPins[0].$name        = "ZUO_IN1";
GPIO1.associatedPins[0].initialValue = "SET";
GPIO1.associatedPins[0].assignedPin  = "9";
GPIO1.associatedPins[1].$name        = "ZUO_IN2";
GPIO1.associatedPins[1].initialValue = "SET";
GPIO1.associatedPins[1].assignedPin  = "10";
GPIO1.associatedPins[2].$name        = "YOU_IN1";
GPIO1.associatedPins[2].initialValue = "SET";
GPIO1.associatedPins[2].assignedPin  = "7";
GPIO1.associatedPins[3].$name        = "YOU_IN2";
GPIO1.associatedPins[3].initialValue = "SET";
GPIO1.associatedPins[3].assignedPin  = "6";

const Board = scripting.addModule("/ti/driverlib/Board", {}, false);

GPIO2.$name                          = "GPIO_XUNJI";
GPIO2.associatedPins.create(8);
GPIO2.associatedPins[0].$name        = "L4";
GPIO2.associatedPins[0].direction    = "INPUT";
GPIO2.associatedPins[0].assignedPort = "PORTB";
GPIO2.associatedPins[0].assignedPin  = "19";
GPIO2.associatedPins[1].$name        = "L3";
GPIO2.associatedPins[1].direction    = "INPUT";
GPIO2.associatedPins[1].assignedPort = "PORTB";
GPIO2.associatedPins[1].assignedPin  = "17";
GPIO2.associatedPins[2].$name        = "L2";
GPIO2.associatedPins[2].direction    = "INPUT";
GPIO2.associatedPins[2].assignedPin  = "16";
GPIO2.associatedPins[2].assignedPort = "PORTA";
GPIO2.associatedPins[3].$name        = "L1";
GPIO2.associatedPins[3].direction    = "INPUT";
GPIO2.associatedPins[3].assignedPort = "PORTA";
GPIO2.associatedPins[3].assignedPin  = "14";
GPIO2.associatedPins[4].$name        = "R1";
GPIO2.associatedPins[4].direction    = "INPUT";
GPIO2.associatedPins[4].assignedPort = "PORTB";
GPIO2.associatedPins[4].assignedPin  = "20";
GPIO2.associatedPins[5].$name        = "R2";
GPIO2.associatedPins[5].direction    = "INPUT";
GPIO2.associatedPins[5].assignedPort = "PORTB";
GPIO2.associatedPins[5].assignedPin  = "25";
GPIO2.associatedPins[6].$name        = "R3";
GPIO2.associatedPins[6].direction    = "INPUT";
GPIO2.associatedPins[6].assignedPort = "PORTA";
GPIO2.associatedPins[6].assignedPin  = "25";
GPIO2.associatedPins[7].$name        = "R4";
GPIO2.associatedPins[7].direction    = "INPUT";
GPIO2.associatedPins[7].assignedPort = "PORTA";
GPIO2.associatedPins[7].assignedPin  = "27";

GPIO3.$name                         = "ENCODER";
GPIO3.port                          = "PORTB";
GPIO3.associatedPins.create(4);
GPIO3.associatedPins[0].$name       = "Left_A";
GPIO3.associatedPins[0].direction   = "INPUT";
GPIO3.associatedPins[0].assignedPin = "5";
GPIO3.associatedPins[0].interruptEn = true;
GPIO3.associatedPins[0].polarity    = "RISE";
GPIO3.associatedPins[1].$name       = "Left_B";
GPIO3.associatedPins[1].direction   = "INPUT";
GPIO3.associatedPins[1].assignedPin = "4";
GPIO3.associatedPins[1].interruptEn = true;
GPIO3.associatedPins[1].polarity    = "FALL";
GPIO3.associatedPins[2].$name       = "Right_A";
GPIO3.associatedPins[2].direction   = "INPUT";
GPIO3.associatedPins[2].assignedPin = "11";
GPIO3.associatedPins[2].interruptEn = true;
GPIO3.associatedPins[2].polarity    = "FALL";
GPIO3.associatedPins[3].$name       = "Right_B";
GPIO3.associatedPins[3].direction   = "INPUT";
GPIO3.associatedPins[3].assignedPin = "12";
GPIO3.associatedPins[3].interruptEn = true;
GPIO3.associatedPins[3].polarity    = "RISE";

GPIO4.$name                         = "OLED";
GPIO4.port                          = "PORTA";
GPIO4.associatedPins.create(2);
GPIO4.associatedPins[0].$name       = "SCL1";
GPIO4.associatedPins[0].assignedPin = "1";
GPIO4.associatedPins[0].ioStructure = "OD";
GPIO4.associatedPins[1].$name       = "SDA1";
GPIO4.associatedPins[1].ioStructure = "OD";
GPIO4.associatedPins[1].assignedPin = "0";

GPIO5.$name                              = "KEY";
GPIO5.port                               = "PORTA";
GPIO5.associatedPins[0].$name            = "KEY1_PIN_A23";
GPIO5.associatedPins[0].direction        = "INPUT";
GPIO5.associatedPins[0].assignedPin      = "23";
GPIO5.associatedPins[0].internalResistor = "PULL_UP";

PWM1.$name                              = "PWMAB";
PWM1.pwmMode                            = "EDGE_ALIGN_UP";
PWM1.timerCount                         = 100;
PWM1.timerStartTimer                    = true;
PWM1.peripheral.$assign                 = "TIMA0";
PWM1.peripheral.ccp0Pin.$assign         = "j21_expansion.3";
PWM1.peripheral.ccp1Pin.$assign         = "j17_expansion.6";
PWM1.PWM_CHANNEL_0.$name                = "ti_driverlib_pwm_PWMTimerCC0";
PWM1.PWM_CHANNEL_1.$name                = "ti_driverlib_pwm_PWMTimerCC1";
PWM1.ccp0PinConfig.$name                = "ti_driverlib_gpio_GPIOPinGeneric0";
PWM1.ccp0PinConfig.direction            = scripting.forceWrite("OUTPUT");
PWM1.ccp0PinConfig.hideOutputInversion  = scripting.forceWrite(false);
PWM1.ccp0PinConfig.onlyInternalResistor = scripting.forceWrite(false);
PWM1.ccp0PinConfig.passedPeripheralType = scripting.forceWrite("Digital");
PWM1.ccp1PinConfig.$name                = "ti_driverlib_gpio_GPIOPinGeneric1";
PWM1.ccp1PinConfig.direction            = scripting.forceWrite("OUTPUT");
PWM1.ccp1PinConfig.hideOutputInversion  = scripting.forceWrite(false);
PWM1.ccp1PinConfig.onlyInternalResistor = scripting.forceWrite(false);
PWM1.ccp1PinConfig.passedPeripheralType = scripting.forceWrite("Digital");

SYSCTL.MFCLKEn = true;

SYSTICK.interruptEnable = true;
SYSTICK.periodEnable    = true;
SYSTICK.systickEnable   = true;
SYSTICK.period          = 32000;

TIMER1.$name            = "TIMER_A1_KONG_ZHI";
TIMER1.timerMode        = "PERIODIC";
TIMER1.interrupts       = ["ZERO"];
TIMER1.timerClkDiv      = 8;
TIMER1.timerPeriod      = "25 ms";
TIMER1.timerClkPrescale = 40;
TIMER1.timerStartTimer  = true;

UART1.$name                            = "UART_1";
UART1.uartClkSrc                       = "MFCLK";
UART1.targetBaudRate                   = 115200;
UART1.peripheral.$assign               = "UART1";
UART1.peripheral.rxPin.$assign         = "boosterpack.3";
UART1.peripheral.txPin.$assign         = "boosterpack.4";
UART1.txPinConfig.$name                = "ti_driverlib_gpio_GPIOPinGeneric2";
UART1.txPinConfig.direction            = scripting.forceWrite("OUTPUT");
UART1.txPinConfig.hideOutputInversion  = scripting.forceWrite(false);
UART1.txPinConfig.onlyInternalResistor = scripting.forceWrite(false);
UART1.txPinConfig.passedPeripheralType = scripting.forceWrite("Digital");
UART1.rxPinConfig.$name                = "ti_driverlib_gpio_GPIOPinGeneric3";
UART1.rxPinConfig.hideOutputInversion  = scripting.forceWrite(false);
UART1.rxPinConfig.onlyInternalResistor = scripting.forceWrite(false);
UART1.rxPinConfig.passedPeripheralType = scripting.forceWrite("Digital");

/**
 * Pinmux solution for unlocked pins/peripherals. This ensures that minor changes to the automatic solver in a future
 * version of the tool will not impact the pinmux you originally saw.  These lines can be completely deleted in order to
 * re-solve from scratch.
 */
GPIO1.associatedPins[0].pin.$suggestSolution = "boosterpack.7";
GPIO1.associatedPins[1].pin.$suggestSolution = "j19_expansion.2";
GPIO1.associatedPins[2].pin.$suggestSolution = "boosterpack.14";
GPIO1.associatedPins[3].pin.$suggestSolution = "boosterpack.13";
Board.peripheral.$suggestSolution            = "DEBUGSS";
Board.peripheral.swclkPin.$suggestSolution   = "j25_expansion.16";
Board.peripheral.swdioPin.$suggestSolution   = "j25_expansion.14";
GPIO2.associatedPins[0].pin.$suggestSolution = "boosterpack.23";
GPIO2.associatedPins[1].pin.$suggestSolution = "boosterpack.18";
GPIO2.associatedPins[2].pin.$suggestSolution = "boosterpack.29";
GPIO2.associatedPins[3].pin.$suggestSolution = "j17_expansion.7";
GPIO2.associatedPins[4].pin.$suggestSolution = "boosterpack.36";
GPIO2.associatedPins[5].pin.$suggestSolution = "j19_expansion.7";
GPIO2.associatedPins[6].pin.$suggestSolution = "boosterpack.2";
GPIO2.associatedPins[7].pin.$suggestSolution = "boosterpack.8";
GPIO3.associatedPins[0].pin.$suggestSolution = "j19_expansion.1";
GPIO3.associatedPins[1].pin.$suggestSolution = "boosterpack.40";
GPIO3.associatedPins[2].pin.$suggestSolution = "j19_expansion.3";
GPIO3.associatedPins[3].pin.$suggestSolution = "boosterpack.19";
GPIO4.associatedPins[0].pin.$suggestSolution = "j17_expansion.9";
GPIO4.associatedPins[1].pin.$suggestSolution = "j19_expansion.9";
GPIO5.associatedPins[0].pin.$suggestSolution = "j17_expansion.10";
SYSCTL.peripheral.$suggestSolution           = "SYSCTL";
TIMER1.peripheral.$suggestSolution           = "TIMA1";
